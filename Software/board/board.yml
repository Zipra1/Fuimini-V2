## Software/board/board.yml
```yaml
# Copyright (c) 2024 Nordic Semiconductor ASA
# SPDX-License-Identifier: Apache-2.0

board:
  name: fuiminiv2_uf2
  vendor: macroplastics
  socs:
    - name: nrf52833
```
